## zephyr/Kconfig
```kconfig
# Copyright (c) 2022 Space Cubics, LLC.
# SPDX-License-Identifier: Apache-2.0

config CANARD
	bool "Enable libcanard"
	help
	  This option enables the libcanard as a Zephyr module.
```
